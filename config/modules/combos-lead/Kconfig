## config/modules/combos-lead/dts/bindings/combos/combos_lead.yaml
```yaml
# DT binding for the Combo-Lead module.

title: ZMK Combos (Combo-Lead)

description: Adds leader-combo specific properties to the stock ZMK combo binding

compatible: "zmk,combos"
extend: true

child-binding:
  description: "A combo with optional leader extra positions"

  properties:
    bindings:
      type: phandle-array
      required: true
    key-positions:
      type: array
      required: true
    key-positions-leader:
      type: array
      required: false
    timeout-ms:
      type: int
      default: 50
    require-prior-idle-ms:
      type: int
      default: -1
    key-positions-first-exclude:
      type: array
      required: false
    slow-release:
      type: boolean
    layers:
      type: array 
```

## modules/combos-lead/Kconfig
```kconfig
config COMBOS_LEAD
    bool "Enable combos-lead module"
    default y

# This is a placeholder Kconfig so that the symbol referenced from the
# user overlay exists.  The actual behavior/runtime code is provided by
# the combos-lead module that is checked out by the workflow. 
```

## west.yml
```yaml
manifest:
  remotes:
    - name: harold
      url-base: https://github.com/harlord
  projects:
    - name: combos-lead
      remote: harold
      revision: main
  self:
    path: config 
```
